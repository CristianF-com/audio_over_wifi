## esp32/main/Kconfig.projbuild
```kconfig
menu "SonosWiFi receiver"

    config RECEIVER_ID
        int "ID del receptor (0-9; 255 = automático, lo asigna la Raspberry por MAC)"
        range 0 255
        default 255
        help
            255 (recomendado): el ESP no lleva número; la Raspberry le da una casilla según su MAC y la recuerda.
            0-9: número fijo (compatible con versiones anteriores). Si el NVS tiene un número, manda el del NVS.

    config WIFI_SSID_DEFAULT
        string "SSID por defecto (el NVS lo sobreescribe)"
        default "TuRedWiFi"

    config WIFI_PASS_DEFAULT
        string "Password por defecto (el NVS lo sobreescribe)"
        default "TuPassword"

    choice SONOS_WIFI_BAND
        prompt "Banda WiFi"
        default SONOS_WIFI_BAND_5G
        help
            El ESP32-C5 no puede usar 2.4 y 5 GHz a la vez. Fijar la banda evita que, con un SSID
            compartido entre bandas, se conecte a 2.4 GHz por tener más señal.

        config SONOS_WIFI_BAND_5G
            bool "Solo 5 GHz (recomendado)"
        config SONOS_WIFI_BAND_AUTO
            bool "Automática (la de mejor señal)"
        config SONOS_WIFI_BAND_2G
            bool "Solo 2.4 GHz"
    endchoice

    config SONOS_WIFI_COUNTRY
        string "Código de país del WiFi (ISO 3166, 2 letras)"
        default "AR"
        help
            Define los canales y la potencia permitidos según la regulación del país. Por defecto
            Argentina ("AR"). Se aplica fijo: no lo cambia el país que anuncie el router.

    config I2S_BCK_GPIO
        int "GPIO de BCK  -> PCM5102A BCK  (XIAO D8 = GPIO8)"
        default 8

    config I2S_WS_GPIO
        int "GPIO de WS   -> PCM5102A LCK  (XIAO D9 = GPIO9)"
        default 9

    config I2S_DOUT_GPIO
        int "GPIO de DOUT -> PCM5102A DIN  (XIAO D10 = GPIO10)"
        default 10

    config SONOS_RPI_IP
        string "IP fija de la RPi (opcional; vacío = solo broadcast). El NVS/BLE la sobreescribe"
        default ""

    config SONOS_LED_GPIO
        int "GPIO del LED de estado (-1 = sin LED)"
        range -1 48
        default 27

    config SONOS_LED_ACTIVE_LOW
        bool "El LED enciende con nivel bajo"
        depends on SONOS_LED_GPIO >= 0
        default y

    config SONOS_BLE_ENABLE
        bool "Configuración por Bluetooth LE (NimBLE)"
        default y

    config SONOS_BLE_WINDOW_S
        int "Segundos con WiFi conectado tras los que el BLE se apaga (sin WiFi sigue activo)"
        depends on SONOS_BLE_ENABLE
        range 5 3600
        default 15

    config SONOS_BLE_REQUIRE_ENC
        bool "Exigir enlace cifrado (emparejamiento Just Works) para escribir"
        depends on SONOS_BLE_ENABLE
        default y

endmenu
```

## esp32_wroom/main/Kconfig.projbuild
```kconfig
menu "SonosWiFi receiver"

    config RECEIVER_ID
        int "ID del receptor (0-9; 255 = automático, lo asigna la Raspberry por MAC)"
        range 0 255
        default 255
        help
            255 (recomendado): el ESP no lleva número; la Raspberry le da una casilla según su MAC y la recuerda.
            0-9: número fijo (compatible con versiones anteriores). Si el NVS tiene un número, manda el del NVS.

    config WIFI_SSID_DEFAULT
        string "SSID por defecto (el NVS lo sobreescribe)"
        default "TuRedWiFi"

    config WIFI_PASS_DEFAULT
        string "Password por defecto (el NVS lo sobreescribe)"
        default "TuPassword"

    config SONOS_WIFI_COUNTRY
        string "Código de país del WiFi (ISO 3166, 2 letras)"
        default "AR"
        help
            Define los canales y la potencia permitidos según la regulación del país. Por defecto
            Argentina ("AR"). Se aplica fijo: no lo cambia el país que anuncie el router.

    config I2S_BCK_GPIO
        int "GPIO de BCK  -> PCM5102A BCK  (ESP32-WROOM: GPIO26)"
        default 26

    config I2S_WS_GPIO
        int "GPIO de WS   -> PCM5102A LCK  (ESP32-WROOM: GPIO25)"
        default 25

    config I2S_DOUT_GPIO
        int "GPIO de DOUT -> PCM5102A DIN  (ESP32-WROOM: GPIO22)"
        default 22

    config SONOS_RPI_IP
        string "IP fija de la RPi (opcional; vacío = solo broadcast). El NVS/BLE la sobreescribe"
        default ""

    config SONOS_LED_GPIO
        int "GPIO del LED de estado (-1 = sin LED)"
        range -1 48
        default -1

    config SONOS_LED_ACTIVE_LOW
        bool "El LED enciende con nivel bajo"
        depends on SONOS_LED_GPIO >= 0
        default n

    config SONOS_BLE_ENABLE
        bool "Configuración por Bluetooth LE (NimBLE)"
        default y

    config SONOS_BLE_WINDOW_S
        int "Segundos con WiFi conectado tras los que el BLE se apaga (sin WiFi sigue activo)"
        depends on SONOS_BLE_ENABLE
        range 5 3600
        default 15

    config SONOS_BLE_REQUIRE_ENC
        bool "Exigir enlace cifrado (emparejamiento Just Works) para escribir"
        depends on SONOS_BLE_ENABLE
        default y

endmenu
```
